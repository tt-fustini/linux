## Documentation/devicetree/bindings/soc/foobar/foobar,cache-controller.yaml
```yaml
# SPDX-License-Identifier: GPL-2.0-only OR BSD-2-Clause
%YAML 1.2
---
$id: http://devicetree.org/schemas/soc/foobar/foobar,cache-controller.yaml#
$schema: http://devicetree.org/meta-schemas/core.yaml#

title: Foobar SoC Cache Controller

maintainers:
  - Drew Fustini <dfustini@baylibre.com>

description:
  Foobar SoC cache controller implements the RISC-V CBQRI interface for
  capacity allocaiton and usage monitoring.

allOf:
  - $ref: /schemas/cache-controller.yaml#
  - $ref: /schemas/riscv/riscv,cbqri.yaml#

properties:
  compatible:
    items:
      - const: foobar,cache-controller
  reg:
    maxItems: 1
    description: A memory region containing registers as defined in CBQRI spec

  '#address-cells':
    const: 1

  '#size-cells':
    const: 0

required:
  - compatible
  - reg

additionalProperties: false

examples:
  - |

    cache-controller@fff12000 {
        compatible = "foobar,cache-controller";
        reg = <0xfff12000 0x2000>;
        cache-level = <2>;
        riscv,cbqri-rcid = <64>;
        riscv,cbqri-mcid = <256>;
    };

...
```

## Documentation/devicetree/bindings/soc/foobar/foobar,memory-controller.yaml
```yaml
# SPDX-License-Identifier: GPL-2.0-only OR BSD-2-Clause
%YAML 1.2
---
$id: http://devicetree.org/schemas/soc/foobar/foobar,memory-controller.yaml#
$schema: http://devicetree.org/meta-schemas/core.yaml#

title: Foobar SoC Memory Controller

maintainers:
  - Drew Fustini <dfustini@baylibre.com>

description:
  Foobar SoC memory controller implements the RISC-V CBQRI interface for
  capacity allocaiton and usage monitoring.

allOf:
  - $ref: /schemas/riscv/riscv,cbqri.yaml#

properties:
  compatible:
    items:
      - const: foobar,memory-controller
  reg:
    maxItems: 1
    description: A memory region containing registers as defined in CBQRI spec

  '#address-cells':
    const: 1

  '#size-cells':
    const: 0

required:
  - compatible
  - reg

additionalProperties: false

examples:
  - |

    memory-controller@fff12000 {
        compatible = "foobar,memory-controller";
        reg = <0xfff12000 0x2000>;
        riscv,cbqri-rcid = <64>;
        riscv,cbqri-mcid = <256>;
    };

...
```

## drivers/platform/arm64/mpam/Kconfig
```kconfig
# Confusingly, this is everything but the CPU bits of MPAM. CPU here means
# CPU resources, not containers or cgroups etc.
config ARCH_HAS_CPU_RESCTRL
	bool
	depends on ARM64 && ARM64_MPAM
	select ACPI_MPAM if ACPI
	select RESCTRL_RMID_DEPENDS_ON_CLOSID

config MPAM_KUNIT_TEST
	bool "KUnit tests for MPAM driver " if !KUNIT_ALL_TESTS
	depends on KUNIT=y
	default KUNIT_ALL_TESTS
	help
	  Enable this option to run tests in the MPAM driver.

	  If unsure, say N.
```

## drivers/soc/foobar/Kconfig
```kconfig
# SPDX-License-Identifier: GPL-2.0

config FOOBAR_CBQRI_CACHE
	bool "Foobar cache controller for RISC-V CBQRI testing"
	default y
	help
	  Support the cache controller in a hypothetical "Foobar" SoC that
	  implements the RISC-V Capacity and Bandwidth QoS Register Interface
	  (CBQRI) specification.

	  If you do not care about testing RISC-V CBQRI, then choose 'N'.

config FOOBAR_CBQRI_MEMORY
	bool "Foobar memory controller for RISC-V CBQRI testing"
	default y
	help
	  Support the memory controller in a hypothetical "Foobar" SoC that
	  implements the RISC-V Capacity and Bandwidth QoS Register Interface
	  (CBQRI) specification.

	  If you do not care about testing RISC-V CBQRI, then choose 'N'.
```
