## Documentation/devicetree/bindings/gpio/tenstorrent,atlantis-gpio.yaml
```yaml
# SPDX-License-Identifier: (GPL-2.0-only OR BSD-2-Clause)
%YAML 1.2
---
$id: http://devicetree.org/schemas/gpio/tenstorrent,atlantis-gpio.yaml#
$schema: http://devicetree.org/meta-schemas/core.yaml#

title: Tenstorrent Atlantis GPIO controller

maintainers:
  - Drew Fustini <dfustini@oss.tenstorrent.com>

description:
  The GPIO controller in the Tenstorrent Atlantis SoC has 32 lines. Each line
  can be configured as an input or an output and can raise an edge or level
  triggered interrupt. The controller has two interrupt outputs and routes
  each line to one of them. A debounce filter with one clock divider shared
  by all lines can be enabled per line.

properties:
  compatible:
    const: tenstorrent,atlantis-gpio

  reg:
    maxItems: 1

  interrupts:
    items:
      - description: First combined interrupt output
      - description: Second combined interrupt output

  clocks:
    maxItems: 1

  resets:
    maxItems: 1

  gpio-controller: true

  "#gpio-cells":
    const: 2

  interrupt-controller: true

  "#interrupt-cells":
    const: 2

  gpio-ranges:
    maxItems: 1

  gpio-line-names:
    maxItems: 32

required:
  - compatible
  - reg
  - interrupts
  - clocks
  - gpio-controller
  - "#gpio-cells"
  - interrupt-controller
  - "#interrupt-cells"

additionalProperties: false

examples:
  - |
    #include <dt-bindings/clock/tenstorrent,atlantis-prcm-rcpu.h>
    #include <dt-bindings/interrupt-controller/irq.h>

    gpio@b0150000 {
        compatible = "tenstorrent,atlantis-gpio";
        reg = <0xb0150000 0x10000>;
        interrupts = <47 IRQ_TYPE_LEVEL_HIGH>, <48 IRQ_TYPE_LEVEL_HIGH>;
        clocks = <&prcm_rcpu CLK_GPIO_PCLK>;
        resets = <&prcm_rcpu RST_GPIO>;
        gpio-controller;
        #gpio-cells = <2>;
        interrupt-controller;
        #interrupt-cells = <2>;
    };
```

## Documentation/devicetree/bindings/pci/tenstorrent,atlantis-pcie.yaml
```yaml
# SPDX-License-Identifier: (GPL-2.0-only OR BSD-2-Clause)
%YAML 1.2
---
$id: http://devicetree.org/schemas/pci/tenstorrent,atlantis-pcie.yaml#
$schema: http://devicetree.org/meta-schemas/core.yaml#

title: Tenstorrent Atlantis PCIe host controller

maintainers:
  - Drew Fustini <fustini@kernel.org>

description:
  The Atlantis SoC has three PCIe Root Complex controllers (x16, x8 and x4)
  based on the Synopsys DesignWare PCIe IP, so they inherit the common
  properties defined in snps,dw-pcie.yaml. The controllers share a PCIe
  subsystem register block which holds their resets, clock gates and the
  AXI sideband that distinguishes DBI accesses from outbound TLPs.

allOf:
  - $ref: /schemas/pci/pci-host-bridge.yaml#
  - $ref: /schemas/pci/snps,dw-pcie.yaml#

properties:
  compatible:
    const: tenstorrent,atlantis-pcie

  reg:
    minItems: 3
    items:
      - description: Data Bus Interface (DBI) registers
      - description: Outbound window for the peripheral configuration space
      - description: Controller application registers
      - description: iATU registers

  reg-names:
    minItems: 3
    items:
      - const: dbi
      - const: config
      - const: app
      - const: atu

  clocks:
    items:
      - description: AXI clock of the controller's master and slave interfaces
      - description: APB clock of the application registers
      - description: Auxiliary clock of the controller's power management logic
      - description: APB clock of the PHY control registers

  clock-names:
    items:
      - const: slv
      - const: pclk
      - const: aux
      - const: phy_reg

  resets:
    items:
      - description: Controller reset
      - description: Application registers reset
      - description: PHY control block reset

  reset-names:
    items:
      - const: core
      - const: app
      - const: phy

  interrupts:
    minItems: 1
    maxItems: 2

  interrupt-names:
    minItems: 1
    items:
      - const: msi
      - const: dma

  interrupt-controller:
    description:
      Interrupt controller node for the INTx interrupts. The node needs its
      own interrupt-parent, because the parent PCIe node's interrupt-cells
      belong to its interrupt-map.
    type: object

    properties:
      "#address-cells":
        const: 0

      "#interrupt-cells":
        const: 1

      interrupt-controller: true

      interrupts:
        items:
          - description: Combined INTx interrupt

    required:
      - "#address-cells"
      - "#interrupt-cells"
      - interrupt-controller
      - interrupts

    additionalProperties: false

  msi-parent: true

  reset-gpios:
    description: GPIO driving the slot PERST# signal.
    maxItems: 1

  tenstorrent,sysreg:
    $ref: /schemas/types.yaml#/definitions/phandle-array
    items:
      - items:
          - description: phandle to the PCIe subsystem register block
          - description: index of this controller within the subsystem
            maximum: 2
    description:
      The PCIe subsystem register block shared by the three controllers,
      and the index selecting this controller's registers within it.

required:
  - compatible
  - reg
  - reg-names
  - clocks
  - clock-names
  - resets
  - reset-names
  - interrupt-controller
  - tenstorrent,sysreg

unevaluatedProperties: false

examples:
  - |
    #include <dt-bindings/gpio/gpio.h>
    #include <dt-bindings/interrupt-controller/irq.h>

    soc {
      #address-cells = <2>;
      #size-cells = <2>;

      pcie@30000000000 {
        compatible = "tenstorrent,atlantis-pcie";
        reg = <0x300 0x00000000 0x0 0x01000000>,
              <0x300 0x01000000 0x0 0x10000000>,
              <0x000 0xd9800000 0x0 0x00800000>;
        reg-names = "dbi", "config", "app";
        #address-cells = <3>;
        #size-cells = <2>;
        device_type = "pci";
        bus-range = <0x00 0xff>;
        linux,pci-domain = <2>;
        num-lanes = <4>;
        ranges = <0x81000000 0x000 0x00000000 0x300 0x11000000 0x00 0x00100000>,
                 <0x82000000 0x000 0x80000000 0x300 0x80000000 0x00 0x80000000>,
                 <0xc3000000 0x301 0x00000000 0x301 0x00000000 0xfe 0x80000000>;
        clocks = <&prcm 12>, <&prcm 15>, <&prcm 25>, <&prcm 19>;
        clock-names = "slv", "pclk", "aux", "phy_reg";
        resets = <&prcm 44>, <&prcm 52>, <&prcm 49>;
        reset-names = "core", "app", "phy";
        interrupts = <109 IRQ_TYPE_LEVEL_HIGH>, <114 IRQ_TYPE_LEVEL_HIGH>;
        interrupt-names = "msi", "dma";
        msi-parent = <&imsic>;
        reset-gpios = <&gpio 15 GPIO_ACTIVE_LOW>;
        tenstorrent,sysreg = <&pcie_sysreg 2>;
        dma-coherent;

        interrupt-controller {
          #address-cells = <0>;
          #interrupt-cells = <1>;
          interrupt-controller;
          interrupt-parent = <&aplic>;
          interrupts = <110 IRQ_TYPE_LEVEL_HIGH>;
        };
      };
    };
...
```

## Documentation/devicetree/bindings/riscv/riscv,cbqri.yaml
```yaml
# SPDX-License-Identifier: GPL-2.0-only OR BSD-2-Clause
%YAML 1.2
---
$id: http://devicetree.org/schemas/riscv/riscv,cbqri.yaml#
$schema: http://devicetree.org/meta-schemas/core.yaml#

title: RISC-V Capacity and Bandwidth Register Interface (CBQRI) properties

description: |
  Common properties for cache and memory controllers that implement the
  RISC-V CBQRI specification:
  https://github.com/riscv/riscv-ssqosid/releases/tag/v1.0

maintainers:
  - Drew Fustini <fustini@kernel.org>

properties:
  riscv,cbqri-rcid:
    $ref: /schemas/types.yaml#/definitions/uint32
    description: The maximum number of RCIDs the controller supports

  riscv,cbqri-mcid:
    $ref: /schemas/types.yaml#/definitions/uint32
    description: The maximum number of MCIDs the controller supports

additionalProperties: true

...
```

## drivers/resctrl/riscv/Kconfig
```kconfig
# SPDX-License-Identifier: GPL-2.0

config RESCTRL_RISCV_CBQRI_CACHE
	bool "RISC-V QoS cache controller (CBQRI)"
	default y
	depends on RISCV
	select RISCV_ISA_SSQOSID
	help
	  Support RISC-V platform which implements a QoS capacity
	  controller according to the RISC-V Capacity and Bandwidth QoS
	  Register Interface (CBQRI) specification.

	  If you do not care about testing RISC-V CBQRI, then choose 'N'.

config RESCTRL_RISCV_CBQRI_BANDWIDTH
	bool "RISC-V QoS bandwidth controller (CBQRI)"
	default y
	depends on RISCV
	select RISCV_ISA_SSQOSID
	help
	  Support RISC-V platform which implements a QoS bandwidth
	  controller according to the RISC-V Capacity and Bandwidth QoS
	  Register Interface (CBQRI) specification.

	  If you do not care about testing RISC-V CBQRI, then choose 'N'.
```
